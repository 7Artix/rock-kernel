/dts-v1/;
/plugin/;

#include <dt-bindings/gpio/gpio.h>
#include <dt-bindings/pinctrl/rockchip.h>

/ {
    metadata {
        title = "ST7735S Display Screen";
        compatible = "radxa,rock-3c-aic8800ds2", "radxa,rock-3c", "rockchip,rk3566";
        category = "screen";
        description = "ST7735S Display Screen";
    };

    fragment@0 {
        target = <&spi3>;
        __overlay__ {
            status = "okay";
            #address-cells = <0x01>;
			#size-cells = <0x00>;

            pinctrl-names = "default";
            pinctrl-0 = <&spi3m1_cs0 &spi3m1_pins>;

            //  // disable dma
            // dmas = <0>, <0>;
            // dma-names = "tx", "rx";

            // spidev@0 {
			// 	compatible = "rockchip,spidev";
			// 	status = "okay";
			// 	reg = <0x00>;
			// 	spi-max-frequency = <12000000>;
			// };

            display@0 {
                status = "okay";
                compatible = "jianda,jd-t18003-t01", "sitronix,st7735r";
                reg = <0>;
                spi-max-frequency = <32000000>;
                // vcc-supply = <&vcc_3v3>;
                dc-gpios = <&gpio4 RK_PB3 GPIO_ACTIVE_HIGH>;
                reset-gpios = <&gpio4 RK_PB2 GPIO_ACTIVE_HIGH>;
                rotation = <90>;
            };
        };
    };
};